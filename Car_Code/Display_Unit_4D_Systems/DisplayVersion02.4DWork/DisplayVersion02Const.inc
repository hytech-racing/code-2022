// File generated 3/8/2018 9:11:29 PM
// Warning! This is a generated file, any manual changes will be
// lost during the next generation.

// object indexes into ImageControl
#CONST
    iGauge0         // offset 0x0
    iStatictext0    // offset 0x145800
    iLeddigits0     // offset 0x147000
    iiLeddigits0    // offset 0x147C00
    iLeddigits1     // offset 0x14BA00
    iiLeddigits1    // offset 0x14C800
    iStatictext1    // offset 0x150800
    iCoolgauge0     // offset 0x152000
    iStatictext2    // offset 0x8CC600
    iLeddigits2     // offset 0x8CFC00
    iiLeddigits2    // offset 0x8D2000
    iStatictext3    // offset 0x8D7600
    iLeddigits3     // offset 0x8D8600
    iiLeddigits3    // offset 0x8DA600
    iStatictext4    // offset 0x8DF400
    iLeddigits4     // offset 0x8E0C00
    iiLeddigits4    // offset 0x8E2800
    iStatictext5    // offset 0x8E6A00
    iImage0         // offset 0x8E8200
#END

#IFNOT EXISTS NOGLOBALS
var hndl ;
#ENDIF
